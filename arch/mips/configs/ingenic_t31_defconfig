## arch/mips/configs/ingenic_t31_defconfig
```kconfig
CONFIG_KERNEL_LZMA=y
CONFIG_SYSVIPC=y
CONFIG_NO_HZ_IDLE=y
CONFIG_BPF_SYSCALL=y
CONFIG_IKCONFIG=y
CONFIG_IKCONFIG_PROC=y
CONFIG_MEMCG=y
CONFIG_BLK_CGROUP=y
CONFIG_CFS_BANDWIDTH=y
CONFIG_CGROUP_PIDS=y
CONFIG_CGROUP_FREEZER=y
CONFIG_CGROUP_DEVICE=y
CONFIG_CGROUP_CPUACCT=y
CONFIG_NAMESPACES=y
CONFIG_USER_NS=y
CONFIG_SCHED_AUTOGROUP=y
CONFIG_BLK_DEV_INITRD=y
CONFIG_EXPERT=y
CONFIG_MACH_INGENIC_SOC=y
CONFIG_CPU_MIPS32_R2=y
CONFIG_HIGHMEM=y
CONFIG_MIPS_O32_FP64_SUPPORT=y
CONFIG_MIPS_CMDLINE_FROM_DTB=y
CONFIG_JUMP_LABEL=y
CONFIG_MODULES=y
CONFIG_MODULE_UNLOAD=y
CONFIG_TRIM_UNUSED_KSYMS=y
# CONFIG_COMPAT_BRK is not set
CONFIG_USERFAULTFD=y
CONFIG_NET=y
CONFIG_PACKET=y
CONFIG_IP_PNP=y
CONFIG_IP_PNP_DHCP=y
CONFIG_NETFILTER=y
CONFIG_BRIDGE=y
CONFIG_NET_DSA=y
CONFIG_NET_9P=y
CONFIG_NET_9P_VIRTIO=y
CONFIG_DEVTMPFS=y
CONFIG_DEVTMPFS_MOUNT=y
CONFIG_MTD=y
CONFIG_MTD_CMDLINE_PARTS=y
CONFIG_MTD_BLOCK=y
CONFIG_MTD_CFI=y
CONFIG_MTD_CFI_INTELEXT=y
CONFIG_MTD_PHYSMAP=y
CONFIG_MTD_PHYSMAP_OF=y
CONFIG_MTD_RAW_NAND=y
CONFIG_MTD_NAND_GPIO=y
CONFIG_MTD_NAND_PLATFORM=y
CONFIG_MTD_NAND_ECC_SW_BCH=y
CONFIG_MTD_SPI_NOR=y
CONFIG_MTD_UBI=y
CONFIG_MTD_UBI_GLUEBI=y
CONFIG_MTD_UBI_BLOCK=y
CONFIG_BLK_DEV_LOOP=y
CONFIG_BLK_DEV_RAM=y
CONFIG_VIRTIO_BLK=y
CONFIG_SRAM=y
CONFIG_EEPROM_93CX6=y
CONFIG_BLK_DEV_SD=y
CONFIG_ATA=y
CONFIG_NETDEVICES=y
CONFIG_VIRTIO_NET=y
CONFIG_LITEX_LITEETH=y
CONFIG_MSCC_OCELOT_SWITCH=y
CONFIG_SMSC911X=y
CONFIG_STMMAC_ETH=y
CONFIG_XILINX_EMACLITE=y
CONFIG_MICROSEMI_PHY=y
CONFIG_SMSC_PHY=y
CONFIG_MDIO_MSCC_MIIM=y
CONFIG_INPUT_EVDEV=y
CONFIG_KEYBOARD_GOLDFISH_EVENTS=y
CONFIG_SERIAL_8250=y
CONFIG_SERIAL_8250_CONSOLE=y
CONFIG_SERIAL_8250_DW=y
CONFIG_SERIAL_8250_INGENIC=y
CONFIG_SERIAL_OF_PLATFORM=y
CONFIG_SERIAL_LITEUART=y
CONFIG_SERIAL_LITEUART_CONSOLE=y
CONFIG_GOLDFISH_TTY=y
CONFIG_VIRTIO_CONSOLE=y
CONFIG_HW_RANDOM=y
CONFIG_HW_RANDOM_INGENIC_TRNG=y
CONFIG_NVMEM_JZ4780_EFUSE=y
CONFIG_I2C=y
CONFIG_I2C_CHARDEV=y
CONFIG_I2C_MUX=y
CONFIG_I2C_DESIGNWARE_CORE=y
CONFIG_I2C_IMG=y
CONFIG_I2C_JZ4780=y
CONFIG_I2C_XILINX=y
CONFIG_SPI=y
CONFIG_SPI_BITBANG=y
CONFIG_SPI_DESIGNWARE=y
CONFIG_SPI_DW_MMIO=y
CONFIG_SPI_INGENIC_SFC=y
CONFIG_SPI_SPIDEV=y
CONFIG_PINCTRL_OCELOT=y
CONFIG_PINCTRL_PISTACHIO=y
CONFIG_GPIO_SYSFS=y
CONFIG_GPIO_GENERIC_PLATFORM=y
CONFIG_GPIO_XILINX=y
CONFIG_POWER_RESET=y
CONFIG_POWER_RESET_SYSCON=y
CONFIG_POWER_RESET_SYSCON_POWEROFF=y
CONFIG_SYSCON_REBOOT_MODE=y
CONFIG_POWER_SUPPLY=y
CONFIG_BATTERY_GOLDFISH=y
# CONFIG_HWMON is not set
CONFIG_WATCHDOG=y
CONFIG_JZ4740_WDT=y
CONFIG_AUXDISPLAY=y
CONFIG_IMG_ASCII_LCD=y
CONFIG_FB=y
CONFIG_FB_GOLDFISH=y
CONFIG_HID_A4TECH=y
CONFIG_HID_APPLE=y
CONFIG_HID_BELKIN=y
CONFIG_HID_CHERRY=y
CONFIG_HID_CHICONY=y
CONFIG_HID_CYPRESS=y
CONFIG_HID_EZKEY=y
CONFIG_HID_KENSINGTON=y
CONFIG_HID_MICROSOFT=y
CONFIG_HID_MONTEREY=y
CONFIG_USB=y
CONFIG_USB_XHCI_HCD=y
CONFIG_USB_EHCI_HCD=y
CONFIG_USB_OHCI_HCD=y
CONFIG_USB_OHCI_HCD_PLATFORM=y
CONFIG_USB_DWC2=y
CONFIG_USB_STORAGE=y
CONFIG_USB_USBNET=y
CONFIG_USB_NET_AX8817X=y
CONFIG_NLS_CODEPAGE_437=y
CONFIG_NLS_ASCII=y
CONFIG_MMC=y
CONFIG_MMC_SDHCI=y
CONFIG_MMC_SPI=y
CONFIG_MMC_DW=y
CONFIG_MMC_JZ4740=y
CONFIG_MMC_CQHCI=y
CONFIG_MMC_LITEX=y
CONFIG_NEW_LEDS=y
CONFIG_LEDS_CLASS=y
CONFIG_LEDS_SYSCON=y
CONFIG_RTC_CLASS=y
CONFIG_RTC_DRV_M41T80=y
CONFIG_RTC_DRV_GOLDFISH=y
CONFIG_DMADEVICES=y
CONFIG_DMA_JZ4780=y
CONFIG_IMG_MDC_DMA=y
CONFIG_VIRTIO_BALLOON=y
CONFIG_VIRTIO_MMIO=y
CONFIG_VIRTIO_MMIO_CMDLINE_DEVICES=y
CONFIG_STAGING=y
# CONFIG_MIPS_PLATFORM_DEVICES is not set
CONFIG_GOLDFISH=y
CONFIG_GOLDFISH_PIPE=y
CONFIG_COMMON_CLK_BOSTON=y
# CONFIG_INGENIC_CGU_JZ4740 is not set
# CONFIG_INGENIC_CGU_JZ4725B is not set
# CONFIG_INGENIC_CGU_JZ4770 is not set
# CONFIG_INGENIC_CGU_JZ4780 is not set
# CONFIG_INGENIC_CGU_X1000 is not set
# CONFIG_INGENIC_CGU_X1830 is not set
CONFIG_COMMON_CLK_PISTACHIO=y
CONFIG_CLKSRC_PISTACHIO=y
CONFIG_INGENIC_OST=y
# CONFIG_IOMMU_SUPPORT is not set
CONFIG_LITEX_SOC_CONTROLLER=y
CONFIG_GOLDFISH_PIC=y
CONFIG_RESET_PISTACHIO=y
CONFIG_PHY_PISTACHIO_USB=y
CONFIG_PHY_INGENIC_USB=y
CONFIG_EXT4_FS=y
CONFIG_EXT4_FS_POSIX_ACL=y
CONFIG_EXT4_FS_SECURITY=y
CONFIG_FS_ENCRYPTION=y
CONFIG_FANOTIFY=y
CONFIG_FUSE_FS=y
CONFIG_CUSE=y
CONFIG_OVERLAY_FS=y
CONFIG_MSDOS_FS=y
CONFIG_VFAT_FS=y
CONFIG_TMPFS=y
CONFIG_TMPFS_POSIX_ACL=y
CONFIG_MISC_FILESYSTEMS=y
CONFIG_SQUASHFS=y
CONFIG_SQUASHFS_XZ=y
CONFIG_SQUASHFS_ZSTD=y
CONFIG_NFS_FS=y
CONFIG_NFS_V3_ACL=y
CONFIG_NFS_V4=y
CONFIG_NFS_V4_2=y
CONFIG_ROOT_NFS=y
CONFIG_CRYPTO_DEV_IMGTEC_HASH=y
# CONFIG_XZ_DEC_X86 is not set
# CONFIG_XZ_DEC_POWERPC is not set
# CONFIG_XZ_DEC_ARM is not set
# CONFIG_XZ_DEC_ARMTHUMB is not set
# CONFIG_XZ_DEC_SPARC is not set
CONFIG_PRINTK_TIME=y
CONFIG_DYNAMIC_DEBUG_CORE=y
CONFIG_DEBUG_INFO_DWARF_TOOLCHAIN_DEFAULT=y
CONFIG_DEBUG_INFO_REDUCED=y
CONFIG_MAGIC_SYSRQ=y
CONFIG_DEBUG_FS=y
# CONFIG_SLUB_DEBUG is not set
CONFIG_PANIC_ON_OOPS=y
CONFIG_RCU_TRACE=y
# CONFIG_FTRACE is not set
CONFIG_CMDLINE_BOOL=y
CONFIG_CMDLINE="earlycon"
```

## arch/mips/configs/isvp_marmot_aip_v20_defconfig
```kconfig
CONFIG_MACH_XBURST2=y
CONFIG_CPU_MIPS32_R2=y
# CONFIG_COMPACTION is not set
CONFIG_CMA=y
CONFIG_SMP=y
CONFIG_NR_CPUS=2
CONFIG_HZ_100=y
CONFIG_PREEMPT=y
# CONFIG_SECCOMP is not set
CONFIG_CROSS_COMPILE="mips-linux-gnu-"
# CONFIG_LOCALVERSION_AUTO is not set
CONFIG_KERNEL_LZMA=y
# CONFIG_SWAP is not set
CONFIG_SYSVIPC=y
CONFIG_POSIX_MQUEUE=y
# CONFIG_CROSS_MEMORY_ATTACH is not set
CONFIG_FHANDLE=y
CONFIG_NO_HZ_FULL=y
CONFIG_HIGH_RES_TIMERS=y
CONFIG_LOG_BUF_SHIFT=14
CONFIG_CC_OPTIMIZE_FOR_SIZE=y
CONFIG_EXPERT=y
CONFIG_SYSCTL_SYSCALL=y
CONFIG_KALLSYMS_ALL=y
# CONFIG_ADVISE_SYSCALLS is not set
# CONFIG_VM_EVENT_COUNTERS is not set
# CONFIG_COMPAT_BRK is not set
CONFIG_SLAB=y
CONFIG_MODULES=y
CONFIG_MODULE_FORCE_LOAD=y
CONFIG_MODULE_UNLOAD=y
CONFIG_MODULE_FORCE_UNLOAD=y
# CONFIG_LBDAF is not set
# CONFIG_BLK_DEV_BSG is not set
CONFIG_PARTITION_ADVANCED=y
# CONFIG_COREDUMP is not set
CONFIG_NET=y
CONFIG_PACKET=y
CONFIG_UNIX=y
CONFIG_INET=y
CONFIG_IP_MULTICAST=y
CONFIG_IP_PNP=y
CONFIG_IP_PNP_DHCP=y
CONFIG_IP_PNP_BOOTP=y
CONFIG_IP_PNP_RARP=y
# CONFIG_INET_XFRM_MODE_TRANSPORT is not set
# CONFIG_INET_XFRM_MODE_TUNNEL is not set
# CONFIG_INET_XFRM_MODE_BEET is not set
# CONFIG_INET_LRO is not set
# CONFIG_IPV6 is not set
CONFIG_NETWORK_PHY_TIMESTAMPING=y
CONFIG_NETFILTER=y
CONFIG_NETFILTER_XT_TARGET_NFLOG=y
CONFIG_NETFILTER_XT_TARGET_NFQUEUE=y
CONFIG_NETFILTER_XT_MATCH_QUOTA=y
CONFIG_IP_SET=y
CONFIG_IP_SET_BITMAP_IPMAC=y
CONFIG_IP_NF_IPTABLES=y
CONFIG_IP_NF_FILTER=y
CONFIG_IP_NF_MANGLE=y
CONFIG_IP_NF_RAW=y
CONFIG_CFG80211=y
CONFIG_NL80211_TESTMODE=y
CONFIG_CFG80211_WEXT=y
CONFIG_MAC80211=y
CONFIG_MAC80211_MESH=y
CONFIG_RFKILL=y
CONFIG_RFKILL_INPUT=y
CONFIG_UEVENT_HELPER_PATH="/sbin/hotplug"
CONFIG_DEVTMPFS=y
CONFIG_DEVTMPFS_MOUNT=y
# CONFIG_STANDALONE is not set
# CONFIG_PREVENT_FIRMWARE_BUILD is not set
# CONFIG_FW_LOADER is not set
# CONFIG_ALLOW_DEV_COREDUMP is not set
CONFIG_DMA_CMA=y
CONFIG_CMA_SIZE_MBYTES=32
CONFIG_CMA_ALIGNMENT=4
CONFIG_MTD=y
CONFIG_MTD_CMDLINE_PARTS=y
CONFIG_MTD_BLOCK=y
CONFIG_INGENIC_SFC_V2=y
CONFIG_MTD_INGENIC_SFC_V2_NORFLASH=y
# CONFIG_BLK_DEV is not set
CONFIG_NETDEVICES=y
CONFIG_INGENIC_MAC=y
CONFIG_INGENIC_MAC_DMA_INTERFACES=y
CONFIG_INGENIC_MAC_AXI_BUS=y
# CONFIG_NET_VENDOR_ARC is not set
# CONFIG_NET_CADENCE is not set
# CONFIG_NET_VENDOR_BROADCOM is not set
# CONFIG_NET_VENDOR_EZCHIP is not set
# CONFIG_NET_VENDOR_INTEL is not set
# CONFIG_NET_VENDOR_MARVELL is not set
# CONFIG_NET_VENDOR_MICREL is not set
# CONFIG_NET_VENDOR_NATSEMI is not set
# CONFIG_NET_VENDOR_QUALCOMM is not set
# CONFIG_NET_VENDOR_RENESAS is not set
# CONFIG_NET_VENDOR_ROCKER is not set
# CONFIG_NET_VENDOR_SAMSUNG is not set
# CONFIG_NET_VENDOR_SEEQ is not set
# CONFIG_NET_VENDOR_SMSC is not set
# CONFIG_NET_VENDOR_STMICRO is not set
# CONFIG_NET_VENDOR_VIA is not set
# CONFIG_NET_VENDOR_WIZNET is not set
CONFIG_PHYLIB=y
# CONFIG_WLAN is not set
# CONFIG_INPUT_MOUSEDEV is not set
# CONFIG_INPUT_KEYBOARD is not set
# CONFIG_INPUT_MOUSE is not set
# CONFIG_SERIO is not set
CONFIG_DEVPTS_MULTIPLE_INSTANCES=y
# CONFIG_LEGACY_PTYS is not set
# CONFIG_DEVKMEM is not set
CONFIG_SERIAL_INGENIC_UART=y
CONFIG_SERIAL_INGENIC_CONSOLE=y
CONFIG_SERIAL_INGENIC_MAGIC_SYSRQ=y
# CONFIG_HW_RANDOM is not set
CONFIG_I2C=y
CONFIG_I2C_INGENIC=y
CONFIG_GPIO_SYSFS=y
# CONFIG_HWMON is not set
CONFIG_WATCHDOG=y
CONFIG_INGENIC_WDT=y
CONFIG_MFD_INGENIC_TCU=y
CONFIG_JZ_AIP_V20=y
CONFIG_SOC_VPU=y
CONFIG_CHANNEL_NODE_NUM=8
CONFIG_VPU_HELIX=y
# CONFIG_VGA_CONSOLE is not set
CONFIG_USB=y
CONFIG_USB_ANNOUNCE_NEW_DEVICES=y
CONFIG_USB_DWC2=y
CONFIG_INGENIC_INNOPHY=y
CONFIG_MMC=y
CONFIG_MMC_SDHCI_INGENIC=y
CONFIG_DMADEVICES=y
CONFIG_INGENIC_PDMAC=y
# CONFIG_MIPS_PLATFORM_DEVICES is not set
# CONFIG_IOMMU_SUPPORT is not set
CONFIG_PWM=y
CONFIG_EXT2_FS=y
CONFIG_EXT4_FS=y
# CONFIG_DNOTIFY is not set
# CONFIG_INOTIFY_USER is not set
CONFIG_VFAT_FS=y
CONFIG_PROC_KCORE=y
CONFIG_TMPFS=y
CONFIG_CONFIGFS_FS=y
CONFIG_JFFS2_FS=y
CONFIG_JFFS2_FS_WBUF_VERIFY=y
CONFIG_JFFS2_FS_XATTR=y
CONFIG_JFFS2_COMPRESSION_OPTIONS=y
CONFIG_CRAMFS=y
CONFIG_SQUASHFS=y
CONFIG_SQUASHFS_XZ=y
CONFIG_NFS_FS=y
CONFIG_ROOT_NFS=y
CONFIG_NLS_CODEPAGE_437=y
CONFIG_NLS_ASCII=y
CONFIG_NLS_ISO8859_1=y
CONFIG_NLS_UTF8=y
CONFIG_PRINTK_TIME=y
# CONFIG_ENABLE_WARN_DEPRECATED is not set
# CONFIG_ENABLE_MUST_CHECK is not set
# CONFIG_SECTION_MISMATCH_WARN_ONLY is not set
CONFIG_MAGIC_SYSRQ=y
CONFIG_PANIC_TIMEOUT=10
# CONFIG_SCHED_DEBUG is not set
# CONFIG_DEBUG_PREEMPT is not set
CONFIG_STACKTRACE=y
# CONFIG_FTRACE is not set
# CONFIG_CRYPTO_MANAGER_DISABLE_TESTS is not set
# CONFIG_CRYPTO_ECHAINIV is not set
CONFIG_CRYPTO_ECB=y
CONFIG_CRYPTO_CMAC=y
# CONFIG_CRYPTO_HW is not set
```

## arch/mips/xburst/Kconfig
```kconfig
menuconfig SOC_TYPE
	tristate "SOC type"
	depends on MACH_XBURST
	default y

if SOC_TYPE
choice
	prompt "SOC types"
	depends on MACH_XBURST
	default SOC_T23

config SOC_T23
	bool "t23"
	select IRQ_INGENIC_CPU
	select CLK_T23
	select INGENIC_INTC
	select PINCTRL
	select PINCTRL_INGENIC
	select CLKSRC_OF
	select CLKDEV_LOOKUP
	select CLKSRC_INGENIC_SYS_OST

endchoice


choice
	prompt "device tree select"
	default DT_NONE
config DT_NONE

if SOC_T23
source "arch/mips/xburst/soc-t23/Kconfig.DT"
endif

endchoice

config INGENIC_BUILTIN_DTB
	select BUILTIN_DTB
	depends on MACH_XBURST
	bool "Ingenic Device Tree build into Kernel."
	default y

choice
	prompt "device tree select"
	default DT_NONE
config DT_NONE

if SOC_T23
source "arch/mips/xburst/soc-t23/Kconfig.DT"
endif

endchoice

config RAW_BOOT
	bool "Raw Boot Kernel"
	select BOOT_RAW
	default n

config KERNEL_4_4_94
	bool "kernel version 4.4.94"
    default y

config EXTAL_CLOCK
	depends on MACH_XBURST
	int "extal clock in MHz"
	default 24

config INGENIC_GPT_CHECK
	depends on MACH_XBURST
	bool "The physical space is larger than the virtual space"
	default y

config SUSPEND_TEST
	bool "auto suspend test"
	default n

config SUSPEND_ALARM_TIME
	int "suspend alarm time(second)"
	depends on SUSPEND_TEST
	default 2

config XBURST_MXUV2
	bool
	default n

endif
```

## arch/mips/xburst/soc-PRJ007/Kconfig.DT
```kconfig
config DT_GOAT
	bool "PRJ007"

config DT_VELA
	bool "PRJ007"

config DT_ZERATUL
	bool "ZERATUL"

config DT_ATLAS
	bool "ATLAS"
```

## arch/mips/xburst/soc-PRJ008/Kconfig.DT
```kconfig
config DT_GOAT_PRJ008
	bool "GOAT PRJ008"

config DT_VELA_PRJ008
	bool "VELA PRJ008"

config DT_ZERATUL_PRJ008
	bool "ZERATUL PRJ008"

config DT_ATLAS_PRJ008
	bool "ATLAS PRJ008"
```

## arch/mips/xburst/soc-t20/chip-t20/isvp/Kconfig
```kconfig
choice
	prompt "Board type"
	depends on PLATFORM_T20_ISVP
	default BOARD_BULL

config BOARD_BULL
       bool "Bull"
       depends on PLATFORM_T20_ISVP

config BOARD_INDUS
       bool "Indus"
       depends on PLATFORM_T20_ISVP

endchoice

config BOARD_NAME
	string
	default "bull" if BOARD_BULL
	default "indus" if BOARD_INDUS
```

## arch/mips/xburst/soc-t23/chip-t23/isvp/Kconfig
```kconfig
choice
	prompt "Board type"
	depends on PLATFORM_T23_ISVP
	default BOARD_INDUS_T23_QFN

config BOARD_PIKE
       bool "Pike"
       depends on PLATFORM_T23_ISVP

config BOARD_INDUS_T23_BGA
       bool "Indus T23 BGA"
       depends on PLATFORM_T23_ISVP

config BOARD_INDUS_T23_QFN
       bool "Indus T23 QFN V1.0"
       depends on PLATFORM_T23_ISVP

config BOARD_INDUS_T23_QFN_V2
       bool "Indus T23 QFN V2.0"
       depends on PLATFORM_T23_ISVP

endchoice

config BOARD_NAME
	string
	default "Pike" if BOARD_PIKE

config BOARD_NAME
	string
	default "Indus_T23_BGA" if BOARD_INDUS_T23_BGA

config BOARD_NAME
	string
	default "Indus_T23_QFN" if BOARD_INDUS_T23_QFN

config BOARD_NAME
	string
	default "Indus_T23_QFN_V2" if BOARD_INDUS_T23_QFN_V2
```

## arch/mips/xburst/soc-t31/chip-t31/isvp/Kconfig
```kconfig
choice
	prompt "Board type"
	depends on PLATFORM_T31_ISVP
	default BOARD_SWAN

config BOARD_SWAN
       bool "Swan"
       depends on PLATFORM_T31_ISVP

config BOARD_INDUS_T31_BGA
       bool "Indus T31 BGA"
       depends on PLATFORM_T31_ISVP

config BOARD_INDUS_T31_QFN
       bool "Indus T31 QFN V1.0"
       depends on PLATFORM_T31_ISVP

config BOARD_INDUS_T31_QFN_V2
       bool "Indus T31 QFN V2.0"
       depends on PLATFORM_T31_ISVP

endchoice

config BOARD_NAME
	string
	default "Swan" if BOARD_SWAN

config BOARD_NAME
	string
	default "Indus_T31_BGA" if BOARD_INDUS_T31_BGA

config BOARD_NAME
	string
	default "Indus_T31_QFN" if BOARD_INDUS_T31_QFN

config BOARD_NAME
	string
	default "Indus_T31_QFN_V2" if BOARD_INDUS_T31_QFN_V2
```

## arch/mips/xburst2/soc-t41/chip-t41/isvp/Kconfig
```kconfig
choice
	prompt "Board type"
	depends on PLATFORM_T41_ISVP
	default BOARD_MARMOT

config BOARD_MARMOT
       bool "Marmot"
       depends on PLATFORM_T41_ISVP

config BOARD_TOMCAT
       bool "tomcat"
       depends on PLATFORM_T41_ISVP
endchoice

config BOARD_NAME
	string
	default "Marmot" if BOARD_MARMOT

config BOARD_NAME
	string
	default "Tomcat" if BOARD_TOMCAT
```

## drivers/clk/ingenic/Kconfig
```kconfig
config COMMON_CLK_INGENIC
	bool
	depends on MACH_XBURST || MACH_XBURST2
	select MFD_SYSCON
	select COMMON_CLK
	select INGENIC_CLK_DEBUG_FS

config INGENIC_CLK_DEBUG_FS
	bool
	depends on DEBUG_FS
	help
	  enable ingenic common clock debugfs

config CLK_T23
	bool
	depends on SOC_T23
	select COMMON_CLK_INGENIC
	help
	  build the ingenic t23 soc clock driver.
```

## drivers/ldc/Kconfig
```kconfig
menuconfig LDC
	bool "Ingenic LDC Support"
	help
	  Ingenic (LDC) support.

if LDC


config INGENIC_LDC
	tristate "Ingenic LDC support"
	depends on MACH_XBURST
	help
	  Generic LDC framework driver for Ingenic soc based
	  machines.



endif
```

## drivers/media/platform/tx-isp-t21/Kconfig
```kconfig
#
# tx-isp config states
#

config TX_ISP_CORE
	bool "Config isp module"
	depends on VIDEO_TX_ISP
        default y

choice
        prompt "select isp controller"
        depends on TX_ISP_CORE
	default APICAL_ISP

config  APICAL_ISP
        bool 'use apical isp'
        depends on (SOC_T20 || SOC_T15 || SOC_T10 || SOC_T30 || SOC_T21)&& TX_ISP_CORE
        help
        use the apical isp controller.

endchoice

#
# sensor driver configuration
#

config BUILT_IN_SENSOR_SETTING
	  bool "built-in sensor setting"
	  depends on VIDEO_TX_ISP && TX_ISP_CORE
	  default n
	  ---help---
	  used for faster bootup.
```

## drivers/media/platform/tx-isp-t23/Kconfig
```kconfig
#
# tx-isp config states
#

config TX_ISP_CORE
	bool "Config isp module"
	depends on VIDEO_TX_ISP
	default y

config INGENIC_ISP_T23
	bool "use ingenic isp"
	depends on (SOC_T23) && TX_ISP_CORE
	depends on VIDEO_TX_ISP
	default y

#
# sensor driver configuration
#

config BUILT_IN_SENSOR_SETTING
	  bool "built-in sensor setting"
	  depends on VIDEO_TX_ISP && TX_ISP_CORE
	  default n
	  ---help---
	  used for faster bootup.

config INGENIC_ZRT_DUAL_MODE
	  bool "enable zrt platform dual sensorm mode"
	  depends on VIDEO_TX_ISP && TX_ISP_CORE
	  default n
	  ---help---
	  used for faster bootup.
```
