## drivers/mmc/core/Kconfig
```kconfig
#
# MMC core configuration
#

config MMC_OP_COND_RETRIES_CNT
	int "MMC mmc_wait_for_app_cmd count"
	default 100
	help
	 The mmc_wait_for_app_cmd number of waiting times,
	 The default value is 100.
```

## drivers/video/ingenic_aip_v20/Kconfig
```kconfig
menuconfig JZ_AIP
	bool "JZ AIP Driver"
	default y

config JZ_AIP_VER
	tristate "JZ AIP Driver"
	depends on JZ_AIP
	default y
	choice
		prompt "aip version"
		depends on JZ_AIP_VER
		config JZ_AIP_V10
			bool "jz aip driver ver1.0"
		config JZ_AIP_V20
			bool "jz aip driver ver2.0"
	endchoice

config AIP_V20_DEBUG
	bool "AIP debug messages"
	depends on JZ_AIP && JZ_AIP_V20
	default n
	help
		Say Y here to enable jz_aip_v2.0 debug.


config AIP_V20_REPAIR_A1
	bool "Adapt AIP to A1"
	depends on JZ_AIP && JZ_AIP_V20
	default n
	help
		Say Y here to fix chain issue in A1.
```

## drivers/video/ingenic_ldc/Kconfig
```kconfig
menuconfig JZ_LDC
    bool "JZ LDC Driver"
    default y
    help
        Support for Ingenic ldc Driver

config INGENIC_LDC
	bool "Ingenic LDC Driver"
    depends on JZ_LDC
    default y
	help
	  Support for Ingenic LDC  operations.
```

## drivers/video/ingenic_vpu/Kconfig
```kconfig
#
# jz_vpu configuration
#
menuconfig JZ_VPU
    bool "jz vpu driver"
    default y
    help
        jz vpu platform dirver

if JZ_VPU
config CHANNEL_NODE_NUM
    int "channel node number"
    default 16

config VPU_NODE_NUM
    depends on JZ_VPU
    int "vpu node number"
    default 2

config JZ_VPU_KERN_ENCODE
    bool "jz vpu kernel encode"
    default n

if JZ_VPU_KERN_ENCODE
config JZ_VPU_KERN_ENCODE_H264
    bool "jz vpu h264 kernel encode"
    default y

config JZ_VPU_KERN_ENCODE_H265
    bool "jz vpu h265 kernel encode"
    default y

config JZ_VPU_KERN_ENCODE_JPEG
    bool "jz vpu jpeg kernel encode"
    default y
endif

source "drivers/video/ingenic_vpu/helix/Kconfig"
source "drivers/video/ingenic_vpu/radix/Kconfig"

endif
```

## drivers/video/ingenic_vpu/helix/Kconfig
```kconfig
config VPU_HELIX
    depends on JZ_VPU
    bool "vpu helix client device of jz_vpu"
    default y

if VPU_HELIX
config VPU_HELIX_NUM
    depends on VPU_HELIX
    int "vpu helix node number"
    default 1
endif
```

## drivers/video/ingenic_vpu/radix/Kconfig
```kconfig
config VPU_RADIX
    depends on JZ_VPU
    bool "vpu radix client device of jz_vpu"
    default y

if VPU_RADIX
config VPU_RADIX_NUM
    depends on VPU_RADIX
    int "vpu radix node number"
    default 1
endif
```

## drivers/video/jz_fb_v14/Kconfig
```kconfig
menuconfig FB_JZ_V14
	tristate "JZ LCDC framebuffer V1.4"
	depends on FB
	select FB_JZ_DISPLAYS_V14
	help
	  Framebuffer support for the PRJ007 SoC.

source "drivers/video/jz_fb_v14/displays/Kconfig"
```

## drivers/video/soc_vpu_t30/Kconfig
```kconfig
#
# soc_vpu configuration
#
menuconfig SOC_VPU
    bool "soc vpu driver"
    default n
    help
        soc vpu platform dirver

if SOC_VPU
config CHANNEL_NODE_NUM
    int "channel node number"
    default 4

config VPU_NODE_NUM
    depends on SOC_VPU
    int "vpu node number"
    default 1

source "drivers/video/soc_vpu_t30/jz_nvpu/Kconfig"
source "drivers/video/soc_vpu_t30/helix/Kconfig"
source "drivers/video/soc_vpu_t30/radix/Kconfig"

endif
```
