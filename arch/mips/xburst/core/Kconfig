## arch/mips/xburst/core/Kconfig
```kconfig
choice
    prompt "Select cache refresh mode"
    default CACHE_REFRESH_NON_LINKED

    config CACHE_REFRESH_LINKED
        bool "Linked cache refresh"
        help
            Refresh multiple caches together.

    config CACHE_REFRESH_NON_LINKED
        bool "Non-linked cache refresh"
        help
            Refresh each cache independently.
endchoice
```

## arch/mips/xburst/soc-PRJ007/Kconfig
```kconfig
choice
	prompt "Chip type"
	depends on SOC_PRJ007
	default CHIP_PRJ007

config CHIP_PRJ007
	bool "chip-PRJ007"
	#TRACEPOINTS are enabled for ISVP and disabled for Zeratul. Differentiate using board-level files.
	#select TRACEPOINTS
	select SYS_SUPPORTS_HIGHMEM
	select GENERIC_CLOCKEVENTS_BROADCAST

endchoice

config KERNEL_3_10
	depends on SOC_PRJ007
	bool "kernel3.10 version"
	default y

if CHIP_PRJ007
source "arch/mips/xburst/soc-PRJ007/chip-PRJ007/Kconfig"
endif
```

## arch/mips/xburst/soc-PRJ007/chip-PRJ007/Kconfig
```kconfig
choice
	prompt "Platform type"
	depends on CHIP_PRJ007
	default PLATFORM_PRJ007_ISVP

config PLATFORM_PRJ007_ISVP
	bool "isvp"

config PLATFORM_PRJ007_ZERATUL
	bool "zeratul"

endchoice

config PRODUCT_NAME
	string
	default "isvp" if PLATFORM_PRJ007_ISVP

config PRODUCT_NAME
	string
	default "zeratul" if PLATFORM_PRJ007_ZERATUL

if PLATFORM_PRJ007_ISVP
source "arch/mips/xburst/soc-PRJ007/chip-PRJ007/isvp/Kconfig"
endif

if PLATFORM_PRJ007_ZERATUL
source "arch/mips/xburst/soc-PRJ007/chip-PRJ007/zeratul/Kconfig"
endif
```

## arch/mips/xburst/soc-PRJ007/chip-PRJ007/isvp/Kconfig
```kconfig
choice
	prompt "Board type"
	depends on PLATFORM_PRJ007_ISVP
	default BOARD_GOAT

config BOARD_GOAT
	bool "Goat"
	select TRACEPOINTS
	depends on PLATFORM_PRJ007_ISVP

config BOARD_VELA
	bool "Vela"
	select TRACEPOINTS
	depends on PLATFORM_PRJ007_ISVP

endchoice

config BOARD_NAME
	string
	default "Goat" if BOARD_GOAT
	default "Vela" if BOARD_VELA
```

## arch/mips/xburst/soc-PRJ007/chip-PRJ007/zeratul/Kconfig
```kconfig
choice
	prompt "Board type"
	depends on PLATFORM_PRJ007_ZERATUL
	default BOARD_ZERATUL_PRJ007

config BOARD_ZERATUL_PRJ007
	bool "Zeratul PRJ007"
	depends on PLATFORM_PRJ007_ZERATUL

endchoice

config BOARD_NAME
	string
	default "Zeratul" if BOARD_ZERATUL_PRJ007
```

## arch/mips/xburst/soc-PRJ008/Kconfig
```kconfig
choice
	prompt "Chip type"
	depends on SOC_PRJ008
	default CHIP_PRJ008

config CHIP_PRJ008
	bool "chip-PRJ008"
	#TRACEPOINTS are enabled for ISVP and disabled for Zeratul. Differentiate using board-level files.
	#select TRACEPOINTS
	select SYS_SUPPORTS_HIGHMEM
	select GENERIC_CLOCKEVENTS_BROADCAST

endchoice

config KERNEL_3_10
	depends on SOC_PRJ008
	bool "kernel3.10 version"
	default y

if CHIP_PRJ008
source "arch/mips/xburst/soc-PRJ008/chip-PRJ008/Kconfig"
endif
```

## arch/mips/xburst/soc-PRJ008/chip-PRJ008/Kconfig
```kconfig
choice
	prompt "Platform type"
	depends on CHIP_PRJ008
	default PLATFORM_PRJ008_ISVP

config PLATFORM_PRJ008_ISVP
	bool "isvp"

config PLATFORM_PRJ008_ZERATUL
	bool "zeratul"

config PLATFORM_PRJ008_ATLAS
	bool "atlas"

endchoice

config PRODUCT_NAME
	string
	default "isvp" if PLATFORM_PRJ008_ISVP

config PRODUCT_NAME
	string
	default "zeratul" if PLATFORM_PRJ008_ZERATUL

config PRODUCT_NAME
	string
	default "atlas" if PLATFORM_PRJ008_ATLAS

if PLATFORM_PRJ008_ISVP
source "arch/mips/xburst/soc-PRJ008/chip-PRJ008/isvp/Kconfig"
endif

if PLATFORM_PRJ008_ZERATUL
source "arch/mips/xburst/soc-PRJ008/chip-PRJ008/zeratul/Kconfig"
endif

if PLATFORM_PRJ008_ATLAS
source "arch/mips/xburst/soc-PRJ008/chip-PRJ008/atlas/Kconfig"
endif
```

## arch/mips/xburst/soc-PRJ008/chip-PRJ008/atlas/Kconfig
```kconfig
choice
	prompt "Board type"
	depends on PLATFORM_PRJ008_ATLAS
	default PRJ008_BOARD_TAURUS_V1

config PRJ008_BOARD_TAURUS_V1
	bool "Taurus_v1"
	depends on PLATFORM_PRJ008_ATLAS

endchoice

config BOARD_NAME
	string
	default "Taurus_v1" if PRJ008_BOARD_TAURUS_V1
```

## arch/mips/xburst/soc-PRJ008/chip-PRJ008/isvp/Kconfig
```kconfig
choice
	prompt "Board type"
	depends on PLATFORM_PRJ008_ISVP
	default PRJ008_BOARD_GOAT

config PRJ008_BOARD_GOAT
	bool "Goat"
	select TRACEPOINTS
	depends on PLATFORM_PRJ008_ISVP

config PRJ008_BOARD_VELA
	bool "Vela"
	select TRACEPOINTS
	depends on PLATFORM_PRJ008_ISVP

endchoice

config BOARD_NAME
	string
	default "Goat" if PRJ008_BOARD_GOAT
	default "Vela" if PRJ008_BOARD_VELA
```

## arch/mips/xburst/soc-PRJ008/chip-PRJ008/zeratul/Kconfig
```kconfig
choice
	prompt "Board type"
	depends on PLATFORM_PRJ008_ZERATUL
	default BOARD_ZERATUL_PRJ008

config BOARD_ZERATUL_PRJ008
	bool "Zeratul PRJ008"
	depends on PLATFORM_PRJ008_ZERATUL

endchoice

config BOARD_NAME
	string
	default "Zeratul" if BOARD_ZERATUL_PRJ008
```

## drivers/dma/jzdma/Kconfig
```kconfig
menu "PRJ008 PDMA Channel Select Configuration"

config AIC_DMA_MODE
	bool "use aic dma mode"
	default y

config SSLV_DMA_MODE
	bool "use sslv dma mode"
	default n

config UART0_DMA_MODE
	bool "use uart0 dma mode"
	default n

config UART1_DMA_MODE
	bool "use uart1 dma mode"
	default n

config UART2_DMA_MODE
	bool "use uart2 dma mode"
	default n

config SSI0_DMA_MODE
	bool "use ssi0 dma mode"
	default y

config I2C0_DMA_MODE
	bool "use i2c0 dma mode"
	default y

config I2C1_DMA_MODE
	bool "use i2c1 dma mode"
	default y

config I2C2_DMA_MODE
	bool "use i2c2 dma mode"
	default y

config AES0_DMA_MODE
	bool "use aes0 dma mode"
	default y

config AES1_DMA_MODE
	bool "use aes1 dma mode"
	default y

config HASH_DMA_MODE
	bool "use hash dma mode"
	default y

config AUTO_DMA_MODE
	bool "use auto dma mode"
	default y

config SADC_DMA_MODE
	bool "use sadc dma mode"
	default n
endmenu
```

## drivers/media/platform/tx-isp-t40/Kconfig
```kconfig
#
# tx-isp config states
#

config TX_ISP_CORE
	bool "Config isp module"
	depends on VIDEO_TX_ISP
        default y
choice
	prompt "select isp controller"
    depends on TX_ISP_CORE
	default INGENIC_ISP

config  INGENIC_ISP
    bool 'use ingenic isp'
	depends on (SOC_T40) && TX_ISP_CORE
    help
    use the ingenic isp controller.

endchoice

#
# sensor driver configuration
#

config BUILT_IN_SENSOR_SETTING
	  bool "built-in sensor setting"
	  depends on VIDEO_TX_ISP && TX_ISP_CORE
	  default n
	  ---help---
	  used for faster bootup.
```

## drivers/media/platform/tx-isp/Kconfig
```kconfig
#
# tx-isp config states
#

config TX_ISP_CORE
	bool "Config isp module"
	depends on VIDEO_TX_ISP
        default y
choice
	prompt "select isp controller"
    depends on TX_ISP_CORE
	default INGENIC_ISP

config  INGENIC_ISP
    bool 'use ingenic isp'
	depends on (SOC_PRJ007 || SOC_PRJ008) && TX_ISP_CORE
    help
    use the ingenic isp controller.

endchoice

#
# sensor driver configuration
#

config BUILT_IN_SENSOR_SETTING
	  bool "built-in sensor setting"
	  depends on VIDEO_TX_ISP && TX_ISP_CORE
	  default n
	  ---help---
	  used for faster bootup.

config INGENIC_MULTI_SENSOR
	  bool "multi sensor mode"
          depends on VIDEO_TX_ISP && TX_ISP_CORE
              default n
                  ---help---
                      used for faster bootup.
     
```

## drivers/mtd/devices/ingenic_sfc_v2/Kconfig
```kconfig
config INGENIC_SFC_V2
	tristate "Ingenic series SFC driver v2"
	depends on MACH_XBURST
	help
		SFC driver version v2.0 for Ingenic series SoCs

if INGENIC_SFC_V2

choice
	prompt "sfc Mode"
	help
	  Select sfc Mode

config SPI_STANDARD_MODE
	bool "standard spi mode"
	depends on INGENIC_SFC_V2
	help
	  Say Y here to enable spi standard mode

config SPI_QUAD_MODE
	bool "quad spi mode"
	depends on INGENIC_SFC_V2
	help
	  Say Y Here to enable spi QUAD MODE
endchoice

choice
	prompt "SFC Data Mode"
	help
	  Select Data Mode

config SFC_PIO_MODE
	bool "PIO mode"
	depends on INGENIC_SFC_V2
	help
	  Say Y here to enable PIO mode

config SFC_DMA_MODE
	bool "DMA mode"
	depends on INGENIC_SFC_V2
	help
	  Say Y here to enable DMA mode

endchoice

config SFC0
	bool "Ingenic series SFC0"
	depends on INGENIC_SFC_V2
	help
		Say Y here to enable sfc 0

if SFC0
config SFC0_SPEED
    int "ingenic SFC speed in MHZ"
	range 10 100
	default 50
	depends on SFC0
	help
	    Select sfc speed.
		Examples:
			50 =>  50 MHZ
choice
	prompt "the SFC0 external memory (nor or nand)"
	help
	  Select the SFC external memory

config SFC0_V2_NORFLASH
	bool "nor"
	depends on SFC0
	select MTD_INGENIC_SFC_V2_NORFLASH

config SFC0_V2_NANDFLASH
	bool "nand"
	depends on SFC0
	select MTD_INGENIC_SFC_V2_NANDFLASH

endchoice

choice
	prompt "the SFC0 controller function pins select"
	help
	  Select the SFC0 function pins

config JZ_SFC0_PA
	bool "GPIO_PA(23 ~ 28) "
	depends on SFC0
endchoice
endif

config SFC1
	bool "Ingenic series SFC1"
	depends on INGENIC_SFC_V2
	help
		Say Y here to enable sfc 1

if SFC1
config SFC1_SPEED
    int "ingenic SFC speed in MHZ"
	range 10 100
	default 50
	depends on SFC1
	help
	    Select sfc speed.
		Examples:
			50 =>  50 MHZ
choice
	prompt "the SFC1 external memory (nor or nand)"
	help
	  Select the SFC external memory

config SFC1_V2_NORFLASH
	bool "nor"
	depends on SFC1
	select MTD_INGENIC_SFC_V2_NORFLASH

config SFC1_V2_NANDFLASH
	bool "nand"
	depends on SFC1
	select MTD_INGENIC_SFC_V2_NANDFLASH

endchoice

choice
	prompt "the SFC1 controller function pins select"
	help
	  Select the SFC1 function pins

config JZ_SFC1_PC1
	bool "GPIO_PC(2 ~ 7) "
	depends on SFC1

config JZ_SFC1_PC2
	bool "GPIO_PC(11 ~ 16)"
	depends on SFC1
endchoice

endif



config MTD_INGENIC_SFC_V2_NORFLASH
	bool "Support ingenic sfc-nor"
	depends on INGENIC_SFC_V2

if MTD_INGENIC_SFC_V2_NORFLASH

choice
	prompt "Erase block size"
	help
	Select nor flash erase block size

config ERASE_SIZE_32K
	bool "sfc-nor 32k erase block"
	depends on MTD_INGENIC_SFC_V2_NORFLASH

config ERASE_SIZE_64K
	bool "sfc-nor 64k erase block"
	depends on MTD_INGENIC_SFC_V2_NORFLASH

endchoice

config JZ_SFC_NOR_RESET
	bool "Reset nor flash in the kernel"
	depends on MTD_INGENIC_SFC_V2_NORFLASH
	help
		Reset nor flash in the kernel
endif

config MTD_INGENIC_SFC_V2_NANDFLASH
	bool "Support ingenic sfc-nand"
	depends on INGENIC_SFC_V2
	select MTD_NAND

endif
```
