## drivers/pwm/Kconfig
```kconfig
menuconfig PWM
	bool "Pulse-Width Modulation (PWM) Support"
	help
	  Generic Pulse-Width Modulation (PWM) support.

	  In Pulse-Width Modulation, a variation of the width of pulses
	  in a rectangular pulse signal is used as a means to alter the
	  average power of the signal. Applications include efficient
	  power delivery and voltage regulation. In computer systems,
	  PWMs are commonly used to control fans or the brightness of
	  display backlights.

	  This framework provides a generic interface to PWM devices
	  within the Linux kernel. On the driver side it provides an API
	  to register and unregister a PWM chip, an abstraction of a PWM
	  controller, that supports one or more PWM devices. Client
	  drivers can request PWM devices and use the generic framework
	  to configure as well as enable and disable them.

	  This generic framework replaces the legacy PWM framework which
	  allows only a single driver implementing the required API. Not
	  all legacy implementations have been ported to the framework
	  yet. The framework provides an API that is backward compatible
	  with the legacy framework so that existing client drivers
	  continue to work as expected.

	  If unsure, say no.

if PWM

config PWM_SYSFS
	bool
	default y if SYSFS

config PWM_AB8500
	tristate "AB8500 PWM support"
	depends on AB8500_CORE && ARCH_U8500
	help
	  Generic PWM framework driver for Analog Baseband AB8500.

	  To compile this driver as a module, choose M here: the module
	  will be called pwm-ab8500.

config PWM_ATMEL_TCB
	tristate "Atmel TC Block PWM support"
	depends on ATMEL_TCLIB && OF
	help
	  Generic PWM framework driver for Atmel Timer Counter Block.

	  A Timer Counter Block provides 6 PWM devices grouped by 2.
	  Devices in a given group must have the same period.

	  To compile this driver as a module, choose M here: the module
	  will be called pwm-atmel-tcb.

config PWM_BFIN
	tristate "Blackfin PWM support"
	depends on BFIN_GPTIMERS
	help
	  Generic PWM framework driver for Blackfin.

	  To compile this driver as a module, choose M here: the module
	  will be called pwm-bfin.

config PWM_IMX
	tristate "i.MX PWM support"
	depends on ARCH_MXC
	help
	  Generic PWM framework driver for i.MX.

	  To compile this driver as a module, choose M here: the module
	  will be called pwm-imx.

config PWM_JZ4740
	tristate "Ingenic JZ4740 PWM support"
	depends on MACH_JZ4740
	help
	  Generic PWM framework driver for Ingenic JZ4740 based
	  machines.

	  To compile this driver as a module, choose M here: the module
	  will be called pwm-jz4740.

config PWM_LPC32XX
	tristate "LPC32XX PWM support"
	depends on ARCH_LPC32XX
	help
	  Generic PWM framework driver for LPC32XX. The LPC32XX SOC has two
	  PWM controllers.

	  To compile this driver as a module, choose M here: the module
	  will be called pwm-lpc32xx.

config PWM_MXS
	tristate "Freescale MXS PWM support"
	depends on ARCH_MXS && OF
	select STMP_DEVICE
	help
	  Generic PWM framework driver for Freescale MXS.

	  To compile this driver as a module, choose M here: the module
	  will be called pwm-mxs.

config PWM_PUV3
	tristate "PKUnity NetBook-0916 PWM support"
	depends on ARCH_PUV3
	help
	  Generic PWM framework driver for PKUnity NetBook-0916.

	  To compile this driver as a module, choose M here: the module
	  will be called pwm-puv3.

config PWM_PXA
	tristate "PXA PWM support"
	depends on ARCH_PXA
	help
	  Generic PWM framework driver for PXA.

	  To compile this driver as a module, choose M here: the module
	  will be called pwm-pxa.

config PWM_SAMSUNG
	tristate "Samsung PWM support"
	depends on PLAT_SAMSUNG
	help
	  Generic PWM framework driver for Samsung.

	  To compile this driver as a module, choose M here: the module
	  will be called pwm-samsung.

config PWM_SPEAR
	tristate "STMicroelectronics SPEAr PWM support"
	depends on PLAT_SPEAR
	depends on OF
	help
	  Generic PWM framework driver for the PWM controller on ST
	  SPEAr SoCs.

	  To compile this driver as a module, choose M here: the module
	  will be called pwm-spear.

config PWM_TEGRA
	tristate "NVIDIA Tegra PWM support"
	depends on ARCH_TEGRA
	help
	  Generic PWM framework driver for the PWFM controller found on NVIDIA
	  Tegra SoCs.

	  To compile this driver as a module, choose M here: the module
	  will be called pwm-tegra.

config  PWM_TIECAP
	tristate "ECAP PWM support"
	depends on SOC_AM33XX || ARCH_DAVINCI_DA8XX
	help
	  PWM driver support for the ECAP APWM controller found on AM33XX
	  TI SOC

	  To compile this driver as a module, choose M here: the module
	  will be called pwm-tiecap.

config  PWM_TIEHRPWM
	tristate "EHRPWM PWM support"
	depends on SOC_AM33XX || ARCH_DAVINCI_DA8XX
	help
	  PWM driver support for the EHRPWM controller found on AM33XX
	  TI SOC

	  To compile this driver as a module, choose M here: the module
	  will be called pwm-tiehrpwm.

config  PWM_TIPWMSS
	bool
	default y if SOC_AM33XX && (PWM_TIECAP || PWM_TIEHRPWM)
	help
	  PWM Subsystem driver support for AM33xx SOC.

	  PWM submodules require PWM config space access from submodule
	  drivers and require common parent driver support.

config PWM_TWL
	tristate "TWL4030/6030 PWM support"
	depends on TWL4030_CORE
	help
	  Generic PWM framework driver for TWL4030/6030.

	  To compile this driver as a module, choose M here: the module
	  will be called pwm-twl.

config PWM_TWL_LED
	tristate "TWL4030/6030 PWM support for LED drivers"
	depends on TWL4030_CORE
	help
	  Generic PWM framework driver for TWL4030/6030 LED terminals.

	  To compile this driver as a module, choose M here: the module
	  will be called pwm-twl-led.

config PWM_VT8500
	tristate "vt8500 PWM support"
	depends on ARCH_VT8500
	help
	  Generic PWM framework driver for vt8500.

	  To compile this driver as a module, choose M here: the module
	  will be called pwm-vt8500.

config PWM_INGENIC
	tristate "Ingenic PWM support"
	depends on MACH_XBURST
	help
	  Generic PWM framework driver for Ingenic soc based
	  machines.

	  To compile this driver as a module, choose M here: the module
	  will be called pwm-ingenic.

config PWM_CHANNEL0_ENABLE
	depends on PWM_INGENIC
	bool "PWM channel0 Enable"
choice
	depends on PWM_CHANNEL0_ENABLE
	prompt "PWM channel0 GPIO select"
	default PWM_CHANNEL0_PC08
config PWM_CHANNEL0_PA17
	bool "PWM channel0 PA17"
config PWM_CHANNEL0_PB30
	bool "PWM channel0 PB30"
config PWM_CHANNEL0_PC08
	bool "PWM channel0 PC08"
endchoice

config PWM_CHANNEL1_ENABLE
	depends on PWM_INGENIC
	bool "PWM channel1 Enable"
choice
	depends on PWM_CHANNEL1_ENABLE
	prompt "PWM channel1 GPIO select"
	default PWM_CHANNEL1_PB26
config PWM_CHANNEL1_PA19
	bool "PWM channel1 PA19"
config PWM_CHANNEL1_PB26
	bool "PWM channel1 PB26"
endchoice

config PWM_CHANNEL2_ENABLE
	depends on PWM_INGENIC
	bool "PWM channel2 Enable"
choice
	depends on PWM_CHANNEL2_ENABLE
	prompt "PWM channel2 GPIO select"
	default PWM_CHANNEL2_PC09
config PWM_CHANNEL2_PA15
	bool "PWM channel2 PA15"
config PWM_CHANNEL2_PB11
	bool "PWM channel2 PB11"
config PWM_CHANNEL2_PB27
	bool "PWM channel2 PB27"
config PWM_CHANNEL2_PC09
	bool "PWM channel2 PC09"
endchoice

config PWM_CHANNEL3_ENABLE
	depends on PWM_INGENIC
	bool "PWM channel3 Enable"
choice
	depends on PWM_CHANNEL3_ENABLE
	prompt "PWM channel3 GPIO select"
	default PWM_CHANNEL3_PB31
config PWM_CHANNEL3_PB13
	bool "PWM channel3 PB13"
config PWM_CHANNEL3_PB28
	bool "PWM channel3 PB28"
config PWM_CHANNEL3_PB31
	bool "PWM channel3 PB31"
config PWM_CHANNEL3_PA14
	bool "PWM channel3 PA14"
endchoice

endif
```

## drivers/video/soc_vpu/Kconfig
```kconfig
#
# jz_vpu configuration
#
menuconfig SOC_VPU
    bool "soc vpu driver"
    default y
    help
        jz vpu platform dirver

if SOC_VPU
config CHANNEL_NODE_NUM
    int "channel node number"
    default 16

config VPU_NODE_NUM
    depends on SOC_VPU
    int "vpu node number"
    default 2

config JZ_VPU_KERN_ENCODE
    bool "soc vpu kernel encode"
    default n

if JZ_VPU_KERN_ENCODE
config JZ_VPU_KERN_ENCODE_H264
    bool "soc vpu h264 kernel encode"
    default y

config JZ_VPU_KERN_ENCODE_H265
    bool "soc vpu h265 kernel encode"
    default y

config JZ_VPU_KERN_ENCODE_JPEG
    bool "soc vpu jpeg kernel encode"
    default y
endif

source "drivers/video/soc_vpu/helix/Kconfig"
source "drivers/video/soc_vpu/radix/Kconfig"

endif
```

## drivers/video/soc_vpu/helix/Kconfig
```kconfig
config VPU_HELIX
    depends on SOC_VPU
    bool "vpu helix client device of soc_vpu"
    default y

if VPU_HELIX
config VPU_HELIX_NUM
    depends on VPU_HELIX
    int "vpu helix node number"
    default 1
endif
```

## drivers/video/soc_vpu/radix/Kconfig
```kconfig
config VPU_RADIX
    depends on SOC_VPU
    bool "vpu radix client device of soc_vpu"
    default y

if VPU_RADIX
config VPU_RADIX_NUM
    depends on VPU_RADIX
    int "vpu radix node number"
    default 1
endif
```

## sound/oss3/Kconfig
```kconfig
config COMPILE_JZSOUND_OSS3_INTO_KO
	tristate "Compile jzsound oss3 driver into ko"
	default y
	help
		Say 'Y' to compile driver into kernel, 'M' to compile driver into ko.
```
