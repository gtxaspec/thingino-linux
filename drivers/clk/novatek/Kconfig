## drivers/clk/novatek/Kconfig
```kconfig
config COMMON_CLK_NA51068
	bool "Clock driver for Novatek NA51068"
	depends on NVT_IVOT_PLAT_NA51068 || NVT_IVOT_PLAT_NA51068_CA53

config COMMON_CLK_NA51055
	bool "Clock driver for Novatek NA51055"
	depends on NVT_IVOT_PLAT_NA51055
```

## drivers/net/ethernet/novatek/na51055/Kconfig
```kconfig
#
# Synopsys network device configuration
#

config NOVATEK_DWC_ETH_QOS_NA51055
	tristate "Novatek DWC Ethernet QOS support"
	depends on NVT_IVOT_PLAT_NA51055 || NET_VENDOR_NOVATEK
        select PHYLIB
        select CRC32
        select MII
        select INET_LRO
        depends on HAS_DMA
        ---help---
          This driver supports the DWC Ethernet QoS
```

## drivers/pinctrl/novatek/Kconfig
```kconfig
config PINCTRL_NA51068
	bool "Novatek NA51068 pin control"
	depends on NVT_IVOT_PLAT_NA51068 || NVT_IVOT_PLAT_NA51068_CA53

config PINCTRL_NA51055
	bool "Novatek NA51055 pin control"
	depends on NVT_IVOT_PLAT_NA51055
```

## drivers/soc/nvt/Kconfig
```kconfig
#
# MediaTek SoC drivers
#
menu "NovaTek SoC drivers"
	depends on ARCH_NVT_IVOT_V7

config NVT_OTP_SUPPORT
	bool "NVT OTP(one time programmable) support"
	depends on ARCH_NVT_IVOT_V7
	default y
	help
	  This option will configure the NVT OTP(one time programmable) function which can be used call OTP api.

config NVT_HDAL_BUILD_IN
	bool "Novatek IVOT HDAL for Media device drivers support"
	depends on ARCH_NVT_IVOT_V7
	select NVT_VOS_KWRAP
	select NVT_HDAL_KDRV_BUILTIN
	default n
	help
	  Enable this option will let a part of your hdal driver link to uImage
	  You could select which module want to link in the submenu.

config NVT_PROFILER
	bool "Novatek Profilers"
	depends on PLAT_NOVATEK
	depends on ARM || ARM64
	depends on FTRACE
	select KPROBES
	select KRETPROBES
	select EVENT_TRACING
	default n

if NVT_HDAL_BUILD_IN
source "drivers/soc/nvt/nvt_hdal/Kconfig"
endif

config NVT_PROFILER
	bool "Novatek Profilers"
	depends on ARCH_NOVATEK
	depends on ARM || ARM64
	select KPROBES
	select KRETPROBES
	select EVENT_TRACING
	select IRQSOFF_TRACER
	default y if ARCH_NOVATEK

endmenu
```

## drivers/soc/nvt/nvt_hdal/Kconfig
```kconfig
menu "Novatek HDAL Drivers"

config NVT_VOS_KWRAP
	bool "Novatek vos basic handling API"
	default y
	depends on NVT_HDAL_BUILD_IN
	help
	  Novatek VOS api to provide basic multi-OS interface.

config NVT_HDAL_KDRV_BUILTIN
	bool "Novatek hdal k-driver built-in part"
	default y
	depends on NVT_HDAL_BUILD_IN
	help
	  Novatek hdal k-driver's built-in

endmenu
```
